// SPDX-License-Identifier: (GPL-2.0 OR MIT)
/*
 * Copyright 2022 Lothar Waßmann <LW@KARO-electronics.de>
 *
 */

/dts-v1/;

/plugin/;

#include "overlays/imx8m-karo-dsi83.dtsi"

&{/chosen} {
	overlays {
		karo-dsi83;
	};
};

&lcdif1 {
	status = "okay";
};
