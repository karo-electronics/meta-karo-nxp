// SPDX-License-Identifier: (GPL-2.0 OR MIT)
/*
 * Copyright (C) 2021 Markus Bauer <mb@karo-electronics.de>
 *
 */

#include "imx8mp-qsxp-ml81-qsbase3.dtsi"
#include "imx8mp-qsxp-ml81-qsbase3-raspi-display.dtsi"
#include "imx8mp-qsxp-ml81-qsbase3-basler.dtsi"

/ {
	model = "Ka-Ro electronics QSXP-ML81 (NXP i.MX8MP) module on QSBASE3 baseboard with Basler Camera and Raspi Display";
};
