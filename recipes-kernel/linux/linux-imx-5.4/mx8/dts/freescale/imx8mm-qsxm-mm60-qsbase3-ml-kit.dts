// SPDX-License-Identifier: (GPL-2.0 OR MIT)
/*
 * Copyright (C) 2020 Markus Bauer <mb@karo-electronics.de>
 *
 */

#include "imx8mm-qsxm-mm60-qsbase3-laird.dts"
#include "imx8m-qs8m-raspi-display.dtsi"
#include "imx8mm-qsxm-mm60-qsbase3-basler.dtsi"

/ {
	model = "Ka-Ro electronics QSXM-MM60 (NXP i.MX8MM) module on QSBASE3 baseboard with Basler Camera, Laird WiFi and Raspi Display";
};

&vpu_g1 {
	status = "okay";
};

&vpu_g2 {
	status = "okay";
};

&vpu_h1 {
	status = "okay";
};
