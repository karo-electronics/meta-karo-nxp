// SPDX-License-Identifier: GPL-2.0-only OR MIT
/* Ka-Ro electronics TX6U-8130 module on MB7 baseboard. */

/dts-v1/;

#include "imx6dl-tx6u-8130.dts"
#include "imx6qdl-tx6-mb7.dtsi"

/ {
	model = "Ka-Ro electronics TX6U-8130 Module on MB7 baseboard";
};
