// SPDX-License-Identifier: GPL-2.0-only OR MIT
/* Ka-Ro electronics TXUL-5010 module on MB7 baseboard. */

/dts-v1/;

#include "imx6ul-txul-5010.dts"
#include "imx6ul-txul-mb7.dtsi"

/ {
	model = "Ka-Ro electronics TXUL-5010 Module on MB7 baseboard";
};
