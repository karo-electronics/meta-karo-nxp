## conf/distro/karo-imx-minimal.conf
```bitbake
# Ka-Ro i.MX Minimal DISTRO

require include/karo-imx-base.inc

DISTRO = "karo-imx-minimal"
DISTRO_NAME = "Ka-Ro i.MX Minimal Distro"

DISTRO_FEATURES:remove = " \
    gobject-introspection-data \
    multiarch \
    pulseaudio \
"

DISTRO_FEATURES_OPTED_OUT += " \
    gobject-introspection-data \
    pulseaudio \
"

# kernelfeatures not needed in minimal
DISTRO_FEATURES_DEFAULTS:remove = " \
    csi-camera \
    imx219 \
    vivante_gpu \
"

MACHINE_EXTRA_RRECOMMENDS:remove = "udev-rules-imx"
```

## conf/distro/karo-imx-wayland.conf
```bitbake
# Ka-Ro i.MX DISTRO with Wayland

require include/karo-imx-base.inc

DISTRO = "karo-imx-wayland"
DISTRO_NAME = "Ka-Ro i.MX Distro with Wayland"

# add support for wayland
DISTRO_FEATURES:append = " \
    opengl \
    vulkan \
    wayland \
"
```

## conf/distro/karo-imx-xwayland.conf
```bitbake
require include/karo-distro.inc

DISTRO = "karo-imx-xwayland"
DISTRO_NAME = "Ka-Ro i.MX Distro with Wayland and X11 compatibility layer"
DISTRO_NAME = "karo-xwayland (Ka-Ro Linux BSP with xwayland backend)"

# add support for xwayland
DISTRO_FEATURES:append = " \
    opengl \
    vulkan \
    wayland \
    x11 \
"

PACKAGECONFIG:append:pn-weston      = " rdp"
PACKAGECONFIG:append:pn-weston-init = " rdp"
```

## conf/machine/qs95-5610.conf
```bitbake
#@TYPE: Machine
#@NAME: Ka-Ro QS95-5610 module
#@SOC: i.MX95
#@DESCRIPTION: Machine configuration for Ka-Ro QS95-5610 module
##@MAINTAINER: Robin Lintermann <rl@karo-electronics.de>

MACHINEOVERRIDES =. "qs95:"

require include/imx95-base.inc
require include/imx95-overlays.inc

IMXBOOT_TARGETS_BASENAME = "flash"

UBOOT_CONFIG[default] = "qs95-5610_defconfig"
UBOOT_CONFIG[mfg] = "qs95-5610_mfg_defconfig"
UBOOT_CONFIG[noenv] = "qs95-5610_noenv_defconfig"

OEI_BOARD  = "qs95-5610"
DDR_TYPE   = "lpddr4x"
DDR_FIRMWARE_NAME = " \
    lpddr4x_dmem_v202409.bin \
    lpddr4x_dmem_qb_v202409.bin \
    lpddr4x_imem_v202409.bin \
    lpddr4x_imem_qb_v202409.bin \
"
OEI_DDR_CONFIG     = "QS95_5610_4000MTS_FW2024.09_timing"
```

## conf/machine/qs95-9610.conf
```bitbake
#@TYPE: Machine
#@NAME: Ka-Ro QS95-9610 module
#@SOC: i.MX95
#@DESCRIPTION: Machine configuration for Ka-Ro QS95-9610 module
##@MAINTAINER: Robin Lintermann <rl@karo-electronics.de>

MACHINEOVERRIDES =. "qs95:"

require include/imx95-base.inc

IMXBOOT_TARGETS_BASENAME = "flash"

UBOOT_CONFIG[default] = "qs95-9610_defconfig"
UBOOT_CONFIG[mfg] = "qs95-9610_mfg_defconfig"
UBOOT_CONFIG[noenv] = "qs95-9610_noenv_defconfig"

OEI_BOARD  = "qs95-9610"
DDR_TYPE   = "lpddr4x"
DDR_FIRMWARE_NAME = " \
    lpddr4x_dmem_v202409.bin \
    lpddr4x_dmem_qb_v202409.bin \
    lpddr4x_imem_v202409.bin \
    lpddr4x_imem_qb_v202409.bin \
"
OEI_DDR_CONFIG     = "QS95_9610_3733MTS_FW2024.09_timing"
OEI_DDR_CONFIG_ECC = "QS95_9610_3733MTS_FW2024.09_timing"

NETWORK_INTERFACES ?= "eth0 eth1"
```

## recipes-kernel/linux/linux-imx/defconfigs/imx95_defconfig
```kconfig
CONFIG_SYSVIPC=y
CONFIG_POSIX_MQUEUE=y
CONFIG_NO_HZ=y
CONFIG_HIGH_RES_TIMERS=y
CONFIG_PREEMPT=y
CONFIG_EXPERT=y
CONFIG_LOG_CPU_MAX_BUF_SHIFT=14
CONFIG_ARCH_NXP=y
CONFIG_ARCH_MXC=y
CONFIG_ARM64_VA_BITS_48=y
CONFIG_SCHED_MC=y
CONFIG_NR_CPUS=6
CONFIG_ARCH_FORCE_MAX_ORDER=14
CONFIG_PM_DEBUG=y
CONFIG_PM_ADVANCED_DEBUG=y
CONFIG_PM_WAKELOCKS=y
CONFIG_PM_WAKELOCKS_LIMIT=0
CONFIG_WQ_POWER_EFFICIENT_DEFAULT=y
CONFIG_CPU_IDLE=y
CONFIG_ARM_PSCI_CPUIDLE=y
CONFIG_CPU_FREQ=y
CONFIG_CPU_FREQ_STAT=y
CONFIG_CPU_FREQ_DEFAULT_GOV_ONDEMAND=y
CONFIG_CPU_FREQ_GOV_POWERSAVE=y
CONFIG_CPU_FREQ_GOV_USERSPACE=y
CONFIG_CPU_FREQ_GOV_CONSERVATIVE=y
CONFIG_CPU_FREQ_GOV_SCHEDUTIL=y
CONFIG_CPUFREQ_DT=y
CONFIG_JUMP_LABEL=y
CONFIG_GCC_PLUGINS=y
CONFIG_GCC_PLUGIN_LATENT_ENTROPY=y
CONFIG_ARM_SCMI_PROTOCOL=y
CONFIG_ARM_SCMI_POWER_CONTROL=y
CONFIG_COMMON_CLK_SCMI=y
CONFIG_ARM_SCMI_CPUFREQ=y
CONFIG_REGULATOR_ARM_SCMI=y
CONFIG_PTP_1588_CLOCK=y
CONFIG_MODULES=y
CONFIG_MODULE_UNLOAD=y
CONFIG_MODVERSIONS=y
CONFIG_SLAB_FREELIST_RANDOM=y
CONFIG_SLAB_FREELIST_HARDENED=y
CONFIG_KSM=y
CONFIG_TRANSPARENT_HUGEPAGE=y
CONFIG_CMA=y
CONFIG_CMA_DEBUGFS=y
CONFIG_NET=y
CONFIG_PACKET=y
CONFIG_UNIX=y
CONFIG_INET=y
CONFIG_IP_PNP=y
CONFIG_IP_PNP_DHCP=y
CONFIG_IP_PNP_BOOTP=y
CONFIG_DNS_RESOLVER=y
CONFIG_CAN=y
CONFIG_UEVENT_HELPER=y
CONFIG_DEVTMPFS=y
CONFIG_DEVTMPFS_MOUNT=y
CONFIG_OF_OVERLAY=y
CONFIG_IMX_SEC_ENCLAVE=y
CONFIG_BLK_DEV_LOOP=y
CONFIG_SRAM=y
CONFIG_EEPROM_AT24=y
CONFIG_SCSI=y
# CONFIG_SCSI_PROC_FS is not set
CONFIG_BLK_DEV_SD=y
# CONFIG_SCSI_LOWLEVEL is not set
CONFIG_PCI_MSI=y
CONFIG_BLK_DEV_NVME=y
CONFIG_NETDEVICES=y
CONFIG_FSL_ENETC=y
CONFIG_NXP_ENETC4=y
CONFIG_NXP_NETC_BLK_CTRL=y
CONFIG_MICREL_PHY=y
CONFIG_INPUT_EVDEV=y
CONFIG_KEYBOARD_GPIO=y
CONFIG_KEYBOARD_MATRIX=y
CONFIG_INPUT_TOUCHSCREEN=y
CONFIG_TOUCHSCREEN_USB_COMPOSITE=y
CONFIG_LEGACY_PTY_COUNT=16
CONFIG_SERIAL_FSL_LPUART=y
CONFIG_SERIAL_FSL_LPUART_CONSOLE=y
CONFIG_I2C_CHARDEV=y
CONFIG_I2C_GPIO=y
CONFIG_I2C_IMX_LPI2C=y
CONFIG_I3C=y
CONFIG_SVC_I3C_MASTER=y
CONFIG_SPI=y
CONFIG_SPI_DEBUG=y
CONFIG_SPI_FSL_LPSPI=y
CONFIG_SPI_GPIO=y
CONFIG_SPI_SPIDEV=y
CONFIG_PINCTRL=y
CONFIG_DEBUG_PINCTRL=y
CONFIG_PINCTRL_IMX_SCMI=y
CONFIG_GPIO_MXC=y
CONFIG_DEBUG_GPIO=y
CONFIG_GPIO_SYSFS=y
CONFIG_W1=y
CONFIG_W1_MASTER_GPIO=y
CONFIG_W1_SLAVE_THERM=y
CONFIG_W1_SLAVE_SMEM=y
CONFIG_W1_SLAVE_DS2433=y
CONFIG_W1_SLAVE_DS2433_CRC=y
CONFIG_POWER_RESET_GPIO=y
CONFIG_THERMAL=y
CONFIG_CPU_THERMAL=y
CONFIG_THERMAL_EMULATION=y
CONFIG_HWMON=y
CONFIG_SENSORS_ARM_SCMI=y
CONFIG_WATCHDOG=y
CONFIG_WATCHDOG_NOWAYOUT=y
CONFIG_IMX7ULP_WDT=y
CONFIG_REGULATOR=y
CONFIG_REGULATOR_DEBUG=y
CONFIG_REGULATOR_FIXED_VOLTAGE=y
CONFIG_REGULATOR_GPIO=y
CONFIG_VIDEO_DEV=y
CONFIG_VIDEO_IMX8_JPEG=m
CONFIG_MXC_VIDEO_WAVE6=m
CONFIG_DRM=y
CONFIG_DRM_IMX95_DPU=y
CONFIG_DRM_IMX95_MIPI_DSI=y
CONFIG_DRM_IMX95_PIXEL_INTERLEAVER=y
CONFIG_DRM_IMX95_PIXEL_LINK=y
CONFIG_DRM_IMX95_LDB=y
CONFIG_DRM_PANEL_SIMPLE=y
CONFIG_DRM_PANTHOR=m
CONFIG_FB=y
CONFIG_FB_MODE_HELPERS=y
CONFIG_BACKLIGHT_CLASS_DEVICE=y
CONFIG_BACKLIGHT_PWM=y
CONFIG_BACKLIGHT_GPIO=y
CONFIG_LOGO=y
CONFIG_SOUND=y
CONFIG_SND=y
CONFIG_SND_HRTIMER=y
CONFIG_SND_DEBUG=y
CONFIG_SND_DEBUG_VERBOSE=y
CONFIG_SND_PCM_XRUN_DEBUG=y
CONFIG_SND_SOC=y
CONFIG_SND_SOC_FSL_SAI=y
CONFIG_SND_SOC_FSL_MICFIL=m
CONFIG_SND_SOC_FSL_XCVR=m
CONFIG_SND_SOC_FSL_MQS=m
CONFIG_SND_IMX_SOC=m
CONFIG_SND_SOC_IMX_SGTL5000=m
CONFIG_SND_SIMPLE_CARD=y
CONFIG_HID_MULTITOUCH=y
CONFIG_USB_CONN_GPIO=y
CONFIG_USB_ANNOUNCE_NEW_DEVICES=y
CONFIG_USB_DYNAMIC_MINORS=y
CONFIG_USB=y
CONFIG_USB_CHIPIDEA=y
CONFIG_USB_CHIPIDEA_UDC=y
CONFIG_USB_CHIPIDEA_HOST=y
CONFIG_USB_DWC3=y
CONFIG_PHY_FSL_IMX8MQ_USB=y
CONFIG_USB_EHCI_HCD=y
CONFIG_USB_STORAGE=y
CONFIG_USB_STORAGE_REALTEK=y
CONFIG_USB_STORAGE_DATAFAB=y
CONFIG_USB_STORAGE_SDDR09=y
CONFIG_USB_STORAGE_SDDR55=y
CONFIG_USB_STORAGE_JUMPSHOT=y
CONFIG_USB_SERIAL=y
CONFIG_USB_SERIAL_CONSOLE=y
CONFIG_USB_SERIAL_GENERIC=y
CONFIG_USB_SERIAL_SIMPLE=y
CONFIG_USB_SERIAL_FTDI_SIO=y
CONFIG_NOP_USB_XCEIV=y
CONFIG_USB_GADGET=y
CONFIG_USB_GADGET_DEBUG=y
CONFIG_USB_GADGET_DEBUG_FS=y
CONFIG_USB_GADGET_VBUS_DRAW=60
CONFIG_USB_CONFIGFS=y
CONFIG_USB_CONFIGFS_SERIAL=y
CONFIG_USB_CONFIGFS_ACM=y
CONFIG_USB_CONFIGFS_OBEX=y
CONFIG_USB_CONFIGFS_NCM=y
CONFIG_USB_CONFIGFS_ECM=y
CONFIG_USB_CONFIGFS_ECM_SUBSET=y
CONFIG_USB_CONFIGFS_RNDIS=y
CONFIG_USB_CONFIGFS_EEM=y
CONFIG_USB_CONFIGFS_MASS_STORAGE=y
CONFIG_USB_CONFIGFS_F_LB_SS=y
CONFIG_USB_CONFIGFS_F_FS=y
CONFIG_USB_CONFIGFS_F_HID=y
CONFIG_USB_ZERO=m
CONFIG_USB_ETH=m
CONFIG_USB_ETH_EEM=y
CONFIG_USB_G_NCM=m
CONFIG_USB_CDC_COMPOSITE=m
CONFIG_USB_MASS_STORAGE=m
CONFIG_USB_G_SERIAL=m
CONFIG_MMC=y
CONFIG_MMC_BLOCK_MINORS=32
CONFIG_MMC_SDHCI=y
CONFIG_MMC_SDHCI_PLTFM=y
CONFIG_MMC_SDHCI_ESDHC_IMX=y
CONFIG_MMC_SPI=y
CONFIG_NEW_LEDS=y
CONFIG_LEDS_CLASS=y
CONFIG_LEDS_GPIO=y
CONFIG_LEDS_SYSCON=y
CONFIG_LEDS_TRIGGERS=y
CONFIG_LEDS_TRIGGER_HEARTBEAT=y
CONFIG_LEDS_TRIGGER_CPU=y
CONFIG_LEDS_TRIGGER_DEFAULT_ON=y
CONFIG_RTC_CLASS=y
CONFIG_RTC_DRV_DS1307=y
CONFIG_RTC_DRV_DS1307_CENTURY=y
CONFIG_DMADEVICES=y
CONFIG_DMADEVICES_DEBUG=y
CONFIG_DMADEVICES_VDEBUG=y
CONFIG_FSL_EDMA=y
CONFIG_MXC_PXP_V3=y
CONFIG_DMABUF_HEAPS=y
CONFIG_DMABUF_SYSFS_STATS=y
CONFIG_DMABUF_HEAPS_SYSTEM=y
CONFIG_DMABUF_HEAPS_CMA=y
CONFIG_CLK_IMX95_BLK_CTL=y
CONFIG_IOMMU_SUPPORT=y
CONFIG_ARM_SMMU_V3=y
CONFIG_IMX_IRQSTEER=y
CONFIG_TIMER_IMX_SYS_CTR=y
CONFIG_RPMSG_CHAR=m
CONFIG_RPMSG_LIFE_CYCLE=y
CONFIG_FSL_IMX9_DDR_PMU=y
CONFIG_NVMEM_IMX_OCOTP=y
CONFIG_IIO=y
CONFIG_IMX93_ADC=y
CONFIG_PWM=y
CONFIG_PWM_IMX_TPM=y
CONFIG_PHY_FSL_IMX9_DPHY_RX=y
CONFIG_PHY_FSL_IMX8MP_LVDS=y
CONFIG_EXT2_FS=y
CONFIG_EXT4_FS=y
CONFIG_FANOTIFY=y
CONFIG_ISO9660_FS=y
CONFIG_JOLIET=y
CONFIG_ZISOFS=y
CONFIG_UDF_FS=y
CONFIG_VFAT_FS=y
CONFIG_TMPFS=y
CONFIG_HUGETLBFS=y
CONFIG_NFS_FS=y
CONFIG_NFS_V4=y
CONFIG_NFS_V4_1=y
CONFIG_NFS_V4_2=y
CONFIG_ROOT_NFS=y
CONFIG_NFS_USE_LEGACY_DNS=y
CONFIG_NLS_DEFAULT="utf-8"
CONFIG_NLS_CODEPAGE_437=y
CONFIG_NLS_ISO8859_1=y
CONFIG_NLS_ISO8859_15=y
CONFIG_NLS_UTF8=y
CONFIG_DMA_CMA=y
CONFIG_CMA_SIZE_MBYTES=256
CONFIG_PRINTK_TIME=y
CONFIG_DYNAMIC_DEBUG=y
CONFIG_FORTIFY_SOURCE=y
CONFIG_BUG_ON_DATA_CORRUPTION=y
CONFIG_MAGIC_SYSRQ=y
CONFIG_DEBUG_FS=y
CONFIG_DEBUG_WX=y
CONFIG_SCHED_STACK_END_CHECK=y
CONFIG_DEBUG_SHIRQ=y
CONFIG_PANIC_ON_OOPS=y
CONFIG_PANIC_TIMEOUT=-1
CONFIG_SOFTLOCKUP_DETECTOR=y
CONFIG_BOOTPARAM_SOFTLOCKUP_PANIC=y
CONFIG_BOOTPARAM_HUNG_TASK_PANIC=y
CONFIG_WQ_WATCHDOG=y
```
