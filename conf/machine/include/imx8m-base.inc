## conf/machine/include/imx8m-base.inc
```bitbake
MACHINEOVERRIDES =. "mx8:mx8m:"

require karo-base.inc
require conf/machine/include/arm/armv8a/tune-cortexa53.inc

SOC_PREFIX = "imx8m"

MACHINE_FEATURES:remove = "nxp8987"

MACHINE_HAS_VIVANTE_KERNEL_DRIVER_SUPPORT = "1"

KARO_BOARD_PMIC ?= "bd71847"

UBOOT_SAVED_DRAM_TIMING_BASE ??= "0x180000"

ATF_PLATFORM ?= "${SOC_FAMILY}"

ATF_BL31_SIZE ??= "0x20000"

IMX_BOOT_UART_BASE ??= "0x30860000"

# Set DDR FIRMWARE
DDR_FIRMWARE_NAME ?= " \
        ddr3_imem_1d.bin \
        ddr3_dmem_1d.bin \
"

PREFERRED_VERSION_opengl-es-cts:aarch64 = "3.2.8.0"

require imx8m-overlays.inc
```

## conf/machine/include/imx8m-overlays.inc
```bitbake
require karo-dtb-overlays.inc

DTB_OVERLAY_INCLUDES = "\
        karo-backlight \
        karo-dsi83 \
        karo-ksz9031 \
        karo-ksz9131 \
        karo-mcp2515 \
        karo-leds \
        karo-pcie \
        karo-sound \
        karo-raspi-display \
"

# DTB overlays
DTB_OVERLAYS ??= ""

DTB_OVERLAYS_generic = "\
        ${@ mach_overlay(d, ":karo-dsi83 karo-gpu", "imx8mp")} \
        ${@ mach_overlay(d, "karo-mb7", "tx8m,tx8p")} \
        karo-rtc \
        ${@ mach_overlay(d, "qs8m-tc358867", "qs8m,qsxm", "tc358867")} \
        ${@ mach_overlay(d, ":karo-panel-et0570", "qs8m,qsxm,tx8m-1622")} \
        ${@ mach_overlay(d, ":karo-panel-etm0350", "qs8m,qsxm,tx8m-1622")} \
        ${@ mach_overlay(d, ":karo-panel-etm0430", "qs8m,qsxm,tx8m-1622")} \
        ${@ mach_overlay(d, ":karo-panel-etm0700", "qs8m,qsxm,tx8m-1622")} \
        ${@ mach_overlay(d, ":karo-panel-tm101jvhg32", "qs8m,qsxm,tx8m-1622")} \
"

DTB_OVERLAYS:append = "\
        ${@ mach_overlay(d, "karo-copro", dist="copro")} \
        ${@ mach_overlay(d, ":karo-vpu", "imx8mn")} \
        ${@ mach_overlay(d, ":tx8m-wifi", "imx8mn")} \
"

DTB_OVERLAYS:append:imx8mp = "\
        karo-dsi83 \
        karo-gpu \
"

DTB_OVERLAYS:append:tx8m = "\
        karo-lvds-panel \
        tx8m-leds \
        tx8m-mcp2515 \
        ${@ mach_overlay(d, ":tx8m-pcie", "imx8mn")} \
        tx8m-sound \
        tx8m-spidev \
"

DTB_OVERLAYS:append:tx8p = "\
        karo-lvds-panel \
        tx8p-flexcan \
        tx8p-pcie \
        tx8p-ft5x06 \
        tx8p-lvds-mb \
        tx8p-mcp2515 \
        tx8p-sound \
        tx8p-spidev \
"

DTB_OVERLAYS:append:tx8m-1620 = "\
        tx8m-1620-lvds-panel \
        tx8m-ft5x06 \
        tx8m-lvds-mb \
"

DTB_OVERLAYS:append:qs8m = "\
        ${@ mach_overlay(d, "qs8m-cam", dist="csi-camera")} \
        qs8m-ksz9031 \
        qs8m-ksz9131 \
        qs8m-raspi-display \
        qs8m-spidev \
"

DTB_OVERLAYS:append:qsxm = "\
        ${@ mach_overlay(d, "qs8m-cam", dist="csi-camera")} \
        karo-vpu \
        qs8m-ksz9031 \
        qs8m-ksz9131 \
        qs8m-raspi-display \
        qs8m-spidev \
        qsxm-laird \
        qsxm-pcie \
        qsxm-qsbase3 \
"

DTB_OVERLAYS:append:qsxp = "\
        karo-vpu \
        ${@ mach_overlay(d, "qsxp-cam", dist="csi-camera")} \
        qsxp-flexcan \
        qsxp-ksz9031 \
        qsxp-ksz9131 \
        qsxp-laird \
        ${@ mach_overlay(d, "qsxp-mipi-lvds-bridge", dist="dsi83")} \
        qsxp-pcie \
        qsxp-qsbase3 \
        qsxp-raspi-display \
        qsxp-spidev \
        ${@ mach_overlay(d, "qsxp-tc358867", dist="tc358867")} \
"

KARO_BASEBOARDS:tx8m-1620 ?= "\
        lvds-mb \
        mb7 \
"

KARO_BASEBOARDS:tx8m-1622 ?= "\
        mb7 \
        mipi-mb \
"

KARO_BASEBOARDS:tx8m-1610 ?= "\
        mb7 \
        mipi-mb \
"

KARO_BASEBOARDS:tx8m-nd00 ?= "\
        mb7 \
        mipi-mb \
"

KARO_BASEBOARDS:tx8p ?= "\
        lvds-mb \
        mb7 \
"

KARO_BASEBOARDS:qs8m ?= "\
        qsbase2 \
        qsbase4 \
"

KARO_BASEBOARDS:qsxm ?= "\
        qsbase3 \
        qsbase4 \
"

KARO_BASEBOARDS:qsxp ?= "\
        qsbase3 \
        qsbase4 \
"

# baseboard DTB specific overlays
KARO_DTB_OVERLAYS[mb7] += "\
        ${@ mach_overlay(d, "karo-copro", dist="copro")} \
        karo-gpu \
        karo-mb7 \
        ${@ mach_overlay(d, "karo-lvds-panel", "imx8mp")} \
        ${@ mach_overlay(d, "tx8m-1620-lvds-panel", "tx8m-1620")} \
        ${@ mach_overlay(d, "karo-panel-et0570,karo-panel-etm0350,karo-panel-etm0430,karo-panel-etm0700", "imx8mp,tx8m-1620")} \
        ${@ mach_overlay(d, "tx8p-flexcan", "imx8mp", "flexcan")} \
        ${@ mach_overlay(d, "tx8m-ft5x06", "tx8m-1620")} \
        ${@ mach_overlay(d, ":tx8m-leds", "imx8mp")} \
        ${@ mach_overlay(d, "tx8p-ft5x06", "imx8mp")} \
        ${@ mach_overlay(d, "tx8p-sound:tx8m-sound", "imx8mp")} \
        ${@ mach_overlay(d, "tx8p-spidev:tx8m-spidev", "imx8mp")} \
"

KARO_DTB_OVERLAYS[lvds-mb] += "\
        ${@ mach_overlay(d, "karo-copro", dist="copro")} \
        karo-gpu \
        ${@ mach_overlay(d, "tx8m-1620-lvds-panel:karo-lvds-panel", "tx8m-1620")} \
        karo-panel-tm101jvhg32 \
        karo-rtc \
        ${@ mach_overlay(d, "tx8m-leds", "imx8mm")} \
        ${@ mach_overlay(d, "tx8m-wifi", "imx8mm", "wifi")} \
        ${@ mach_overlay(d, "tx8p-lvds-mb:tx8m-lvds-mb", "imx8mp")} \
        ${@ mach_overlay(d, "tx8p-sound:tx8m-sound", "imx8mp")} \
        ${@ mach_overlay(d, "tx8p-spidev:tx8m-spidev", "imx8mp")} \
        ${@ mach_overlay(d, "tx8p-pcie:tx8m-pcie", "imx8mp")} \
"

KARO_DTB_OVERLAYS[mipi-mb] += "\
        ${@ mach_overlay(d, "karo-copro", dist="copro")} \
        ${@ mach_overlay(d, ":karo-dsi83", "tx8m-1622")} \
        karo-gpu \
        ${@ mach_overlay(d, ":karo-lvds-panel", "tx8m-1622")} \
        ${@ mach_overlay(d, ":karo-panel-tm101jvhg32", "tx8m-1622")} \
        karo-rtc \
        tx8m-leds \
        tx8m-sound \
        tx8m-spidev \
        ${@ mach_overlay(d, "tx8m-wifi", "imx8mm", "wifi")} \
"

KARO_DTB_OVERLAYS[qsbase2] += "\
        ${@ mach_overlay(d, "karo-copro", dist="copro")} \
        karo-gpu \
        ${@ mach_overlay(d, "qs8m-cam", "imx8mm", "imx219")} \
        qs8m-ksz9031 \
        ${@ mach_overlay(d, "qs8m-raspi-display", dist="raspi-display")} \
        qs8m-spidev \
"

KARO_DTB_OVERLAYS[qsbase3] += "\
        ${@ mach_overlay(d, "karo-copro", dist="copro")} \
        karo-gpu \
        ${@ mach_overlay(d, "qsxp-flexcan", dist="flexcan")} \
        ${@ mach_overlay(d, "qs8m-cam", "imx8mm", "csi-camera")} \
        ${@ mach_overlay(d, "qsxp-ksz9031:qs8m-ksz9031", "imx8mp")} \
        ${@ mach_overlay(d, "qsxp-laird:qsxm-laird", "imx8mp", "wifi")} \
        ${@ mach_overlay(d, "qsxp-pcie:qsxm-pcie", "imx8mp", "pcie")} \
        ${@ mach_overlay(d, "qsxp-qsbase3:qsxm-qsbase3", "imx8mp")} \
        ${@ mach_overlay(d, "qsxp-raspi-display:qs8m-raspi-display", "imx8mp", "raspi-display")} \
        ${@ mach_overlay(d, "qsxp-spidev:qs8m-spidev", "imx8mp")} \
"

KARO_DTB_OVERLAYS[qsbase4] += "\
        ${@ mach_overlay(d, "karo-copro", dist="copro")} \
        karo-gpu \
        ${@ mach_overlay(d, "qsxp-flexcan", dist="flexcan")} \
        ${@ mach_overlay(d, "qsxp-ksz9131:qs8m-ksz9131", "imx8mp")} \
        ${@ mach_overlay(d, "qsxp-raspi-display:qs8m-raspi-display", "imx8mp", "raspi-display")} \
        ${@ mach_overlay(d, "qsxp-spidev:qs8m-spidev", "imx8mp")} \
"

KARO_DTB_OVERLAYS = "${@ d.getVarFlag('KARO_DTB_OVERLAYS', (d.getVar('KARO_BASEBOARD') or "None"), True) or ""}"
```

## conf/machine/include/imx8mn-base.inc
```bitbake
MACHINEOVERRIDES =. "mx8mn:"

require imx8m-base.inc

SOC_FAMILY = "imx8mn"
ATF_BL31_BASE ??= "0x960000"
IMX_WDOG_B_RESET = "0"
```

## conf/machine/include/imx8mp-base.inc
```bitbake
MACHINEOVERRIDES =. "mx8mp:"

require imx8m-base.inc

SOC_FAMILY = "imx8mp"
ATF_BL31_BASE ??= "0x970000"
IMX_WDOG_B_RESET = "1"
```

## conf/machine/include/imx91-base.inc
```bitbake
require karo-base.inc
require conf/machine/include/arm/armv8-2a/tune-cortexa55.inc

MACHINEOVERRIDES =. "mx91:"

SOC_PREFIX = "imx91"

KARO_BOARD_PMIC ?= "pca9450"

ATF_PLATFORM ?= "imx91"

ATF_BL31_BASE ??= "0x204c0000"
ATF_BL31_SIZE ??= "0x20000"

UBOOT_SAVED_DRAM_TIMING_BASE ??= "0x20490000"

IMX_BOOT_UART_BASE ??= "0x44380000"

# Set DDR FIRMWARE
DDR_FIRMWARE_NAME ?= " \
        lpddr4_imem_1d_v202201.bin \
        lpddr4_dmem_1d_v202201.bin \
        lpddr4_imem_2d_v202201.bin \
        lpddr4_dmem_2d_v202201.bin \
"

PREFERRED_VERSION_opengl-es-cts:aarch64 = "3.2.7.0"
```

## conf/machine/include/imx91-overlays.inc
```bitbake
require karo-dtb-overlays.inc

DTB_OVERLAY_INCLUDES = " \
        karo-backlight \
        karo-lcd-panel \
        karo-ili2130 \
        karo-mcp2515 \
        karo-leds \
        karo-sound \
"

DTB_OVERLAYS_generic = "\
        karo-panel-et0570 \
        karo-panel-etm0430 \
        karo-panel-etm0350 \
        karo-panel-etm0700 \
        karo-panel-tm101jvhg32 \
"

DTB_OVERLAYS_generic:append:tx91 = "\
        karo-mb7 \
"

DTB_OVERLAYS ??= ""

DTB_OVERLAYS:append:qs91 = " \
        qs91-eqos-ksz9031 \
        qs91-eqos-ksz9131 \
        qs91-ft5x06 \
        qs91-i2c-rtc \
        qs91-ili2130 \
        qs91-lcd-panel \
        qs91-qsbase1 \
        qs91-sound \
"

DTB_OVERLAYS:append:tx91 = " \
        tx91-flexcan \
        tx91-ft5x06 \
        tx91-i2c-rtc \
        tx91-ili2130 \
        tx91-lcd-panel \
        tx91-matrix-keypad \
        tx91-sound \
        tx91-spidev \
"

KARO_BASEBOARDS:qs91 += "\
        qsbase1 \
        qsbase4 \
"

KARO_BASEBOARDS:tx91 += "\
        lvds-mb \
        mb7 \
"

#
# KARO_DTB_OVERLAYS[<baseboard>] lists all overlays that will be
# included in the default list of overlays to be loaded for a specific
# baseboard.
#
KARO_DTB_OVERLAYS[lvds-mb] += " \
        tx91-i2c-rtc \
"

KARO_DTB_OVERLAYS[mb7] += " \
        tx91-lcd-panel \
        karo-panel-et0570,karo-panel-etm0430,karo-panel-etm0350,karo-panel-etm0700,karo-panel-tm101jvhg32 \
        karo-mb7 \
        ${@ mach_overlay(d, "tx91-flexcan", dist="flexcan")} \
        tx91-ft5x06,tx91-ili2130 \
        tx91-matrix-keypad \
        tx91-sound \
"

KARO_DTB_OVERLAYS[qsbase4] += " \
        qs91-eqos-ksz9131 \
"

KARO_DTB_OVERLAYS[qsbase1] += " \
        qs91-eqos-ksz9031 \
        qs91-lcd-panel \
        karo-panel-et0570,karo-panel-etm0430,karo-panel-etm0350,karo-panel-etm0700,karo-panel-tm101jvhg32 \
        qs91-qsbase1 \
        qs91-ft5x06,qs91-ili2130 \
"
```

## conf/machine/include/imx93-base.inc
```bitbake
require karo-base.inc
require conf/machine/include/arm/armv8-2a/tune-cortexa55.inc

MACHINEOVERRIDES =. "mx93:"

SOC_PREFIX = "imx93"

KARO_BOARD_PMIC ?= "pca9450"

#SECO_FIRMWARE_NAME = "mx93a1-ahab-container.img"

ATF_PLATFORM ?= "imx93"

ATF_BL31_BASE ??= "0x204e0000"
ATF_BL31_SIZE ??= "0x25000"

UBOOT_SAVED_DRAM_TIMING_BASE ??= "0x2051c000"

IMX_BOOT_UART_BASE ??= "0x44380000"

# Set DDR FIRMWARE
DDR_FIRMWARE_NAME ?= " \
        lpddr4_imem_1d_v202201.bin \
        lpddr4_dmem_1d_v202201.bin \
        lpddr4_imem_2d_v202201.bin \
        lpddr4_dmem_2d_v202201.bin \
"

PREFERRED_VERSION_opengl-es-cts:aarch64 = "3.2.7.0"
```

## conf/machine/include/karo-base.inc
```bitbake
KBUILD_BUILD_USER := "support"
KBUILD_BUILD_HOST := "karo-electronics.de"

BUILD_REPRODUCIBLE_BINARIES ?= "0"
INHERIT:remove = "${@'reproducible_build' if d.getVar('BUILD_REPRODUCIBLE_BINARIES') == '0' else ''}"

require conf/machine/include/imx-base.inc

# override unconditional assignment in meta-imx/.../imx-base-extend.inc
QEMUVERSION = "8.2.7"

MACHINE_FEATURES += "emmc"

MACHINE_HAS_VIVANTE_KERNEL_DRIVER_SUPPORT = "0"

SOC_FAMILY ??= "${SOC_PREFIX}"
MACHINEOVERRIDES =. "${@ "${SOC_FAMILY}:" if "${SOC_FAMILY}" != "${SOC_PREFIX}" else ""}"

UBOOT_CONFIG ??= "default mfg noenv"
UBOOT_FEATURES ??= ""
UBOOT_FEATURES:append = "${@ " pmic-${KARO_BOARD_PMIC}" if "${KARO_BOARD_PMIC}" != "" else ""}"
UBOOT_FEATURES:append = "${@ " optee" if 'optee' in d.getVar('MACHINE_FEATURES').split() else ""}"

SOC_DEFAULT_IMAGE_FSTYPES = "tar.bz2"

# Set U-Boot DTB
KARO_BASEBOARD ??= ""
DTB_BASENAME ?= "${SOC_FAMILY}-${MACHINE}"
U_BOOT_DTB_NAME ?= "${@ "${DTB_BASENAME}%s" % ("-${KARO_BASEBOARD}" if "${KARO_BASEBOARD}" != "" else "")}"

KERNEL_DEVICETREE += "freescale/${DTB_BASENAME}.dtb"

BOOT_TOOLS = "imx-boot-tools"

SPL_BINARY = "spl/u-boot-spl.bin"

# Set Serial console
# The override is required to overrule the unconditional 'SERIAL_CONSOLES = ...'
# setting in meta-freescale/conf/machine/include/imx-base.inc
SERIAL_CONSOLES:mx9-nxp-bsp ?= "115200;ttyLP0 115200;ttyLP1 115200;ttyLP2"
SERIAL_CONSOLES:mx8-nxp-bsp ?= "115200;ttymxc0 115200;ttymxc1 115200;ttymxc2"

IMAGE_BOOTLOADER = "u-boot"

LOADADDR = ""
UBOOT_SUFFIX = "bin"
UBOOT_MAKE_TARGET = ""

IMX_DEFAULT_BSP = "nxp"
PREFERRED_PROVIDER_virtual/bootloader = "u-boot-karo"
PREFERRED_PROVIDER_virtual/kernel = "linux-karo"
PREFERRED_VERSION_linux-karo ?= "6.6"
PREFERRED_VERSION_uboot-karo ?= "2025.07"

PREFERRED_PROVIDER_ptpd = "ptpd"

# Blacklist evbug kernel module
KERNEL_MODULE_PROBECONF += "evbug"
module_conf_evbug = "blacklist evbug"

PREFERRED_VERSION_isp-imx                 = "4.2.2.24+basler"
PREFERRED_VERSION_basler-camera           = "4.2.2.24+basler"
PREFERRED_VERSION_kernel-module-isp-vvcam = "4.2.2.24+basler"

PREFERRED_PROVIDER_opencl-headers:imxgpu = "imx-gpu-viv"
PREFERRED_PROVIDER_opencl-icd-loader:imxgpu = "imx-gpu-viv"
PREFERRED_PROVIDER_virtual/libgles3:imxgpu3d = "imx-gpu-viv"

# Set a more generic tuning for code reuse across parts
# taken from imx-base.inc
DEFAULTTUNE:mx8m-nxp-bsp   ?= "armv8a-crc-crypto"
DEFAULTTUNE:mx9-nxp-bsp   ?= "armv8a-crc-crypto"

PACKAGECONFIG:append:pn-gstreamer1.0-plugins-ugly = " x264"
PACKAGECONFIG:append:pn-systemd = " unmanaged-network"
```

## conf/machine/include/tx8m-base.inc
```bitbake
require karo-base.inc
require conf/machine/include/arm/armv8a/tune-cortexa53.inc

MACHINEOVERRIDES =. "mx8:mx8m:"

require ${@ "imx8mm-base.inc" if 'mx8mm' in d.getVar('MACHINEOVERRIDES').split(':') else ""}
require ${@ "imx8mn-base.inc" if 'mx8mn' in d.getVar('MACHINEOVERRIDES').split(':') else ""}
require ${@ "imx8mp-base.inc" if 'mx8mp' in d.getVar('MACHINEOVERRIDES').split(':') else ""}

SOC_PREFIX = "imx8m"

MACHINE_FEATURES:remove = "nxp8987"

MACHINE_HAS_VIVANTE_KERNEL_DRIVER_SUPPORT = "1"

KARO_BOARD_PMIC ?= "bd71847"

UBOOT_SAVED_DRAM_TIMING_BASE ??= "0x180000"

ATF_PLATFORM ?= "${SOC_FAMILY}"

ATF_BL31_SIZE ??= "0x20000"

IMX_BOOT_UART_BASE ??= "0x30860000"

# Set DDR FIRMWARE
DDR_FIRMWARE_NAME ?= " \
        ddr3_imem_1d.bin \
        ddr3_dmem_1d.bin \
"

PREFERRED_VERSION_opengl-es-cts:aarch64 = "3.2.8.0"
```
