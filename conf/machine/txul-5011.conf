## conf/machine/txul-5011.conf
```bitbake
#@TYPE: Machine
#@NAME: Ka-Ro electronics TX6UL eMMC
#@SOC: i.MX6UL
#@DESCRIPTION: Machine configuration for Ka-Ro electronics TXUL-5011 (i.MX6UL) Computer-On-Module with eMMC
#@MAINTAINER:  Ka-Ro electronics GmbH <support@karo-electronics.com>

require include/imx6ul-txul-emmc.conf

KERNEL_DEVICETREE ?= "imx6ul-tx6ul-0011.dtb \
		      imx6ul-txul-5011-mb7.dtb \
"

UBOOT_MACHINE = "tx6ul-0011_config"
```
