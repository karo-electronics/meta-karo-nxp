## conf/layer.conf
```bitbake
# We have a conf and classes directory, add to BBPATH
BBPATH .= ":${LAYERDIR}"

# We have a packages directory, add to BBFILES
BBFILES += "${LAYERDIR}/recipes-*/*/*.bb \
            ${LAYERDIR}/recipes-*/*/*.bbappend"

BBFILE_COLLECTIONS += "karo-nxp"
BBFILE_PATTERN_karo-nxp := "^${LAYERDIR}/"
BBFILE_PRIORITY_karo-nxp = "10"

LAYERDEPENDS_karo-nxp = "core networking-layer meta-python"
LAYERSERIES_COMPAT_karo-nxp = "mickledore"

# since nxp assumes them for any machine, we have to remove them here
MACHINE_FEATURES:remove = " \
        nxp8801-sdio \
        nxp8987-sdio \
        nxp8997-pcie \
        nxp8997-sdio \
        nxp9098-pcie \
        nxp9098-sdio \
        nxpiw416-sdio \
        nxpiw612-sdio \
"
```

## conf/machine/include/imx6dl-tx6-nand.conf
```bitbake
#@TYPE: Machine
#@NAME: Ka-Ro electronics i.MX6DL TX6DL Computer-On-Module
#@SOC: i.MX6DL
#@DESCRIPTION: Machine configuration for Ka-Ro electronics TX6DL Computer-On-Module
#@MAINTAINER: Oliver Wendt <ow@karo-electronics.com>

require tx6-base.inc
require conf/machine/include/tune-cortexa9.inc

TXTYPE = "imx6dl-tx6"
TXNVM = "nand"

IS_MODULE_TX6 = "yes"

MACHINEOVERRIDES =. "mx6:mx6dl:tx6:${TXTYPE}-${TXNVM}:"
```

## conf/machine/include/imx6q-tx6-nand.conf
```bitbake
#@TYPE: Machine
#@NAME: Ka-Ro electronics i.MX6Q TX6Q Computer-On-Module
#@SOC: i.MX6Q
#@DESCRIPTION: Machine configuration for Ka-Ro electronics TX6Q Computer-On-Module
#@MAINTAINER: Lothar Waßmann <LW@KARO-electronics.de>

require tx6-base.inc
require conf/machine/include/tune-cortexa9.inc

TXTYPE = "imx6q-tx6"
TXNVM = "nand"

IS_MODULE_TX6 = "yes"

MACHINEOVERRIDES =. "mx6:mx6q:tx6:${TXTYPE}-${TXNVM}:"
```

## conf/machine/include/imx6ul-txul-emmc.conf
```bitbake
#@TYPE: Machine
#@NAME: Ka-Ro electronics TX6UL eMMC
#@SOC: i.MX6UL
#@DESCRIPTION: Machine configuration for Ka-Ro electronics TX6UL (i.MX6UL) Computer-On-Module with eMMC
#@MAINTAINER: Oliver Wendt <ow@karo-electronics.com>

require tx6-base.inc
require conf/machine/include/tune-cortexa7.inc

TXTYPE = "imx6ul-tx6"
TXNVM = "emmc"

IS_MODULE_TXUL = "yes"

MACHINEOVERRIDES =. "mx6ul:txul:${TXTYPE}-${TXNVM}:"
```

## conf/machine/include/imx6ull-txul-emmc.conf
```bitbake
#@TYPE: Machine
#@NAME: Ka-Ro electronics TX6ULL eMMC
#@SOC: i.MX6ULL
#@DESCRIPTION: Machine configuration for Ka-Ro electronics TX6ULL (i.MX6ULL) Computer-On-Module with eMMC
#@MAINTAINER: Oliver Wendt <ow@karo-electronics.com>

require tx6-base.inc
require conf/machine/include/tune-cortexa7.inc

TXTYPE = "imx6ull-txul"
TXNVM = "emmc"

IS_MODULE_TXUL = "yes"

MACHINEOVERRIDES =. "mx6ul:txul:${TXTYPE}-${TXNVM}:"
```

## conf/machine/include/tx6-base.inc
```bitbake
require conf/machine/include/imx-base.inc

KBUILD_BUILD_USER := "support"
KBUILD_BUILD_HOST := "karo-electronics.de"

UBOOT_MAKE_TARGET ??= "u-boot.bin"
UBOOT_SUFFIX ??= "bin"

UBOOT_ENTRYPOINT_mx6  = "0x10008000"
UBOOT_ENTRYPOINT_mx6ul = "0x80008000"

# 'cortexa9-neon' 'cortexa9hf-neon'
DEFAULTTUNE_mx6 ?= "cortexa9hf-neon"
DEFAULTTUNE_mx6ul ?= "cortexa7hf-neon"

PREFERRED_PROVIDER_virtual/xserver = "xserver-xorg"
XSERVER_DRIVER = "xf86-video-fbdev"
XSERVER_DRIVER_mx6 = "xf86-video-modesetting"
XSERVER = "xserver-xorg \
           xf86-input-evdev \
           ${XSERVER_DRIVER}"

PACKAGE_EXCLUDE_COMPLEMENTARY = ".*"

PREFERRED_PROVIDER_virtual/egl ?= "mesa"
PREFERRED_PROVIDER_virtual/libgles1 ?= "mesa"
PREFERRED_PROVIDER_virtual/libgles2 ?= "mesa"
PREFERRED_PROVIDER_virtual/libgl ?= "mesa"
PREFERRED_PROVIDER_virtual/libg2d_mx6 ?= "mesa"
PREFERRED_PROVIDER_virtual/libg2d_mx6ul ?= ""

PREFERRED_PROVIDER_virtual/kernel ??= "linux-imx"
PREFERRED_VERSION_linux-imx ?= "4.14.98"
KERNEL_IMAGETYPE = "uImage"
KERNEL_FEATURES += "wifi systemd"

#MACHINE_ESSENTIAL_EXTRA_RDEPENDS = " \
#                 linux-firmware-imx-sdma-imx6q \
#"
#MACHINE_ESSENTIAL_EXTRA_RDEPENDS_append_karo-x11 = " \
#                 linux-firmware-imx-vpu \
#"

# Ship kernel modules
MACHINE_EXTRA_RRECOMMENDS = " \
                          kernel-modules \
"

SERIAL_CONSOLES = "115200;ttymxc0"
SERIAL_CONSOLES_mxs = "115200;ttyAMA0"

MACHINE_FEATURES = " \
                 alsa \
                 rtc \
                 serial \
                 touchscreen \
                 usbgadget \
                 usbhost \
                 vfat \
"

# Add the ability to specify _imx machines
MACHINEOVERRIDES =. "imx:"

# Default baseboard name
TXBASE_DEFAULT_mx6 ?= "mb7"
TXBASE_DEFAULT_mx6ul ?= "evalkit"

# Remove some image types we don't need
IMAGE_FSTYPES_remove = " sdcard ext4"

TXBASE ?= "${TXBASE_DEFAULT}"
```

## conf/machine/include/tx8-base.inc
```bitbake
#@TYPE: Machine
#@NAME: Ka-Ro electronics NXP i.MX8MM TX8M Computer-On-Module
#@SOC: i.MX8MM
#@DESCRIPTION: Machine configuration for Ka-Ro electronics TX8M Computer-On-Module
#@MAINTAINER: Ka-Ro electronics GmbH <support@karo-electronics.com>
#@VERSION: 1
#@DATE: 2019-04-12

MACHINEOVERRIDES =. "mx8:mx8m:mx8mm:tx8m:"

require conf/machine/include/imx-base.inc
require conf/machine/include/arm/arch-arm64.inc

MACHINE_FEATURES += " optee qca9377 qca6174"
MACHINE_FEATURES += " pci wifi bluetooth"
#MACHINE_FEATURES_remove = " bluetooth"

UBOOT_CONFIG ??= "default"
UBOOT_CONFIG[default] = "tx8m-1610_config"
UBOOT_CONFIG[noenv] = "tx8m-1610_noenv_config"
UBOOT_CONFIG[mfg] = "tx8m-1610_mfg_config"
UBOOT_CONFIG[secure-boot] = "tx8m-1610_sec_config"

SPL_BINARY = "spl/u-boot-spl.bin"

# Set DDR FIRMWARE
DDR_FIRMWARE_NAME = "ddr3_imem_1d.bin ddr3_dmem_1d.bin"

# Set imx-mkimage boot target
IMXBOOT_TARGETS = "flash_tx8m"

# Set Serial console
SERIAL_CONSOLE = "115200 ttymxc0"

IMAGE_BOOTLOADER = "imx-boot"

BOOT_SPACE = "65536"

LOADADDR = ""
UBOOT_SUFFIX = "bin"
UBOOT_MAKE_TARGET = ""
IMX_BOOT_SEEK = "33"

PREFERRED_VERSION_linux-karo ?= "4.14.78%"

#IMAGE_FSTYPES_remove = " sdcard ext4 sdcard.bz2"

DL_DIR ?= "${BSPDIR}/downloads/"
```

## conf/machine/qs8m-mq00.conf
```bitbake
#@TYPE: Machine
#@NAME: Ka-Ro electronics NXP i.MX8MM QS8M-MQ00 Computer-On-Module
#@SOC: i.MX8MM
#@DESCRIPTION: Machine configuration for Ka-Ro electronics QS8M-MQ00 Computer-On-Module
#@MAINTAINER: Ka-Ro electronics GmbH <support@karo-electronics.com>
#@VERSION: 1
#@DATE: 2020-01-20

require include/tx8m-base.inc

MACHINEOVERRIDES_append = "qs8m-mq00:"

# u-boot configs
UBOOT_CONFIG[default] = "qs8m-mq00_config"
UBOOT_CONFIG[noenv] = "qs8m-mq00_noenv_config"
UBOOT_CONFIG[mfg] = "qs8m-mq00_mfg_config"
UBOOT_CONFIG[secure-boot] = "qs8m-mq00_sec_config"

IMX_BOOT_SEEK = "33"

# Set U-Boot DTB
UBOOT_DTB_NAME = "imx8mm-qs8m-mq00.dtb"

# Ka-Ro specific Device Tree files to be compiled
KERNEL_DEVICETREE = "freescale/imx8mm-qs8m-mq00.dtb freescale/imx8mm-qs8m-mq00-qsbase2.dtb freescale/imx8mm-qs8m-mq00-qsbase2-raspi-display.dtb"
```

## conf/machine/qs8m-nd00.conf
```bitbake
#@TYPE: Machine
#@NAME: Ka-Ro electronics NXP i.MX8MN QS8M-ND00 Computer-On-Module
#@SOC: i.MX8MN
#@DESCRIPTION: Machine configuration for Ka-Ro electronics QS8M-ND00 Computer-On-Module
#@MAINTAINER: Ka-Ro electronics GmbH <support@karo-electronics.com>
#@VERSION: 1
#@DATE: 2020-08-10

MACHINEOVERRIDES =. "qs8m:mx8mn:"

require include/tx8m-base.inc

KARO_BOARD_PMIC = "rn5t567"

# u-boot configs
UBOOT_CONFIG[default] = "qs8m-nd00_config"
UBOOT_CONFIG[noenv] = "qs8m-nd00_noenv_config"
UBOOT_CONFIG[mfg] = "qs8m-nd00_mfg_config"
UBOOT_CONFIG[secure-boot] = "qs8m-nd00_sec_config"

IMX_BOOT_SEEK = "32"

# Set U-Boot DTB
UBOOT_DTB_NAME = "imx8mn-qs8m-nd00-qsbase2.dtb"

# Ka-Ro specific Device Tree files to be compiled
KERNEL_DEVICETREE = "\
        freescale/imx8mn-qs8m-nd00.dtb \
        freescale/imx8mn-qs8m-nd00-qsbase2.dtb \
        freescale/imx8mn-qs8m-nd00-qsbase2-raspi-display.dtb \
        freescale/imx8mn-qs8m-nd00-qsbase2-dsi83.dtb \
"
```

## conf/machine/qs93-5210.conf
```bitbake
#@TYPE: Machine
#@NAME: Ka-Ro electronics NXP i.MX93 QS93-5210 Computer-On-Module
#@SOC: i.MX93
#@DESCRIPTION: Machine configuration for Ka-Ro electronics QS93-5210 Computer-On-Module
#@MAINTAINER: Ka-Ro electronics GmbH <support@karo-electronics.com>
#@VERSION: 1
#@DATE: 2023-01-27

MACHINEOVERRIDES =. "qs93:"

require include/imx93-base.inc

KARO_BOARD_PMIC = "pca9450"

IMX_BOOT_UART_BASE ?= "0x44380000"

# u-boot configs
UBOOT_CONFIG[default] = "qs93-5210_config"
UBOOT_CONFIG[mfg] = "qs93-5210_mfg_config"
UBOOT_CONFIG[noenv] = "qs93-5210_noenv_config"
```

## conf/machine/qsxp-ml81.conf
```bitbake
#@TYPE: Machine
#@NAME: Ka-Ro electronics NXP i.MX8MP QSXP-ML81 Computer-On-Module
#@SOC: i.MX8MP
#@DESCRIPTION: Machine configuration for Ka-Ro electronics QSXP-ML81 Computer-On-Module
#@MAINTAINER: Ka-Ro electronics GmbH <support@karo-electronics.com>
#@VERSION: 1
#@DATE: 2020-08-10

MACHINEOVERRIDES =. "mx8mp:"

require include/tx8m-base.inc

# u-boot configs
UBOOT_CONFIG[default] = "qsxp-ml81_config"
UBOOT_CONFIG[noenv] = "qsxp-ml81_noenv_config"
UBOOT_CONFIG[mfg] = "qsxp-ml81_mfg_config"
UBOOT_CONFIG[secure-boot] = "qsxp-ml81_sec_config"

IMX_BOOT_SEEK = "32"

# Set U-Boot DTB
UBOOT_DTB_NAME = "imx8mp-qsxp-ml81-qsbase3.dtb"

# Ka-Ro specific Device Tree files to be compiled
KERNEL_DEVICETREE = " \
        freescale/imx8mp-qsxp-ml81.dtb \
        freescale/imx8mp-qsxp-ml81-qsbase3.dtb \
"
```

## conf/machine/tx6q-1030.conf
```bitbake
#@TYPE: Machine
#@NAME: Ka-Ro electronics i.MX6Q TX6Q Computer-On-Module
#@SOC: i.MX6Q
#@DESCRIPTION: Machine configuration for Ka-Ro electronics TX6Q-1030 Computer-On-Module
#@MAINTAINER: Ka-Ro electronics GmbH <support@karo-electronics.com>

require include/imx6q-tx6-nand.conf

KERNEL_DEVICETREE ?= "imx6q-tx6q-1010.dtb \
"

UBOOT_MACHINE = "tx6q-10x0_config"
```

## conf/machine/tx6q-8037.conf
```bitbake
#@TYPE: Machine
#@NAME: Ka-Ro electronics i.MX6QP TX6QP Computer-On-Module
#@SOC: i.MX6QP
#@DESCRIPTION: Machine configuration for Ka-Ro electronics TX6Q-8037 Computer-On-Module
#@MAINTAINER: Ka-Ro electronics GmbH <support@karo-electronics.com>

require include/imx6qp-tx6-emmc.conf

KERNEL_DEVICETREE ?= "imx6qp-tx6qp-8037.dtb \
                      imx6qp-tx6qp-8037-mb7.dtb \
"

UBOOT_MACHINE = "tx6qp-8037_config"
```

## conf/machine/tx6q-8137.conf
```bitbake
#@TYPE: Machine
#@NAME: Ka-Ro electronics i.MX6QP TX6QP Computer-On-Module
#@SOC: i.MX6QP
#@DESCRIPTION: Machine configuration for Ka-Ro electronics TX6Q-8137 Computer-On-Module
#@MAINTAINER: Ka-Ro electronics GmbH <support@karo-electronics.com>

require include/imx6qp-tx6-emmc.conf

KERNEL_DEVICETREE ?= "imx6qp-tx6qp-8137-mb7.dtb imx6qp-tx6qp-8137.dtb"

UBOOT_MACHINE = "tx6qp-8137_config"
TXBASE_append = "-lvds"
```

## conf/machine/tx6s-8034.conf
```bitbake
#@TYPE: Machine
#@NAME: Ka-Ro electronics i.MX6S TX6S Computer-On-Module
#@SOC: i.MX6S
#@DESCRIPTION: Machine configuration for Ka-Ro electronics TX6S-8034 Computer-On-Module
#@MAINTAINER: Ka-Ro electronics GmbH <support@karo-electronics.com>

require include/imx6dl-tx6-nand.conf

KERNEL_DEVICETREE ?= "imx6dl-tx6s-8034-mb7.dtb imx6dl-tx6s-8034.dtb"

UBOOT_MACHINE = "tx6s-8034_config"
```

## conf/machine/tx6s-8035.conf
```bitbake
#@TYPE: Machine
#@NAME: Ka-Ro electronics i.MX6S TX6S Computer-On-Module
#@SOC: i.MX6S
#@DESCRIPTION: Machine configuration for Ka-Ro electronics TX6S-8035 Computer-On-Module
#@MAINTAINER: Ka-Ro electronics GmbH <support@karo-electronics.com>

require include/imx6dl-tx6-emmc.conf

KERNEL_DEVICETREE ?= "imx6dl-tx6s-8035-mb7.dtb imx6dl-tx6s-8035.dtb"

UBOOT_MACHINE = "tx6s-8035_config"
```

## conf/machine/tx6u-8030.conf
```bitbake
#@TYPE: Machine
#@NAME: Ka-Ro electronics i.MX6DL TX6DL Computer-On-Module
#@SOC: i.MX6DL
#@DESCRIPTION: Machine configuration for Ka-Ro electronics TX6DL Computer-On-Module
#@MAINTAINER: Oliver Wendt <ow@karo-electronics.com>

require include/imx6dl-tx6-nand.conf

KERNEL_DEVICETREE ?= "imx6dl-tx6u-80xx-mb7.dtb imx6dl-tx6u-801x.dtb"

UBOOT_MACHINE = "tx6u-80x0_config"
```

## conf/machine/tx6u-8033.conf
```bitbake
#@TYPE: Machine
#@NAME: Ka-Ro electronics i.MX6DL TX6DL Computer-On-Module
#@SOC: i.MX6DL
#@DESCRIPTION: Machine configuration for Ka-Ro electronics TX6U-8033 Computer-On-Module
#@MAINTAINER: Ka-Ro electronics GmbH <support@karo-electronics.com>

require include/imx6dl-tx6-emmc.conf

KERNEL_DEVICETREE ?= "imx6dl-tx6u-8033-mb7.dtb imx6dl-tx6u-8033.dtb"

UBOOT_MACHINE = "tx6u-8033_config"
```

## conf/machine/tx6u-8130.conf
```bitbake
#@TYPE: Machine
#@NAME: Ka-Ro electronics i.MX6DL TX6DL Computer-On-Module
#@SOC: i.MX6DL
#@DESCRIPTION: Machine configuration for Ka-Ro electronics TX6U-8130 Computer-On-Module
#@MAINTAINER: Ka-Ro electronics GmbH <support@karo-electronics.com>

require include/imx6dl-tx6-nand.conf

KERNEL_DEVICETREE ?= "imx6dl-tx6u-81xx-mb7.dtb imx6dl-tx6u-811x.dtb"

UBOOT_MACHINE = "tx6u-81x0_config"
TXBASE_append = "-lvds"
```

## conf/machine/tx8m-1610.conf
```bitbake
#@TYPE: Machine
#@NAME: Ka-Ro electronics NXP i.MX8MM TX8M-1610 Computer-On-Module
#@SOC: i.MX8MM
#@DESCRIPTION: Machine configuration for Ka-Ro electronics TX8M-1610 Computer-On-Module
#@MAINTAINER: Ka-Ro electronics GmbH <support@karo-electronics.com>
#@VERSION: 1
#@DATE: 2019-04-12

MACHINEOVERRIDES =. "tx8m:mx8mm:"

require include/tx8m-base.inc

# u-boot configs
UBOOT_CONFIG[default] = "tx8m-1610_config"
UBOOT_CONFIG[noenv] = "tx8m-1610_noenv_config"
UBOOT_CONFIG[mfg] = "tx8m-1610_mfg_config"
UBOOT_CONFIG[secure-boot] = "tx8m-1610_sec_config"

IMX_BOOT_SEEK = "33"
```

## conf/machine/tx8m-1620.conf
```bitbake
#@TYPE: Machine
#@NAME: Ka-Ro electronics NXP i.MX8MM TX8M-1620 Computer-On-Module
#@SOC: i.MX8MM
#@DESCRIPTION: Machine configuration for Ka-Ro electronics TX8M-1620 Computer-On-Module
#@MAINTAINER: Ka-Ro electronics GmbH <support@karo-electronics.com>
#@VERSION: 1
#@DATE: 2019-12-03

MACHINEOVERRIDES =. "mx8mm:"

require include/tx8m-base.inc

# u-boot configs
UBOOT_CONFIG[default] = "tx8m-1620_config"
UBOOT_CONFIG[noenv] = "tx8m-1620_noenv_config"
UBOOT_CONFIG[mfg] = "tx8m-1620_mfg_config"
UBOOT_CONFIG[secure-boot] = "tx8m-1620_sec_config"

IMX_BOOT_SEEK = "33"

# Set U-Boot DTB
UBOOT_DTB_NAME = "imx8mm-tx8m-1620.dtb"

# Ka-Ro specific Device Tree files to be compiled
KERNEL_DEVICETREE = "\
        freescale/imx8mm-tx8m-1620.dtb \
        freescale/imx8mm-tx8m-1620-lvds-mb.dtb \
"
```

## conf/machine/tx8m-nd00.conf
```bitbake
#@TYPE: Machine
#@NAME: Ka-Ro electronics NXP i.MX8MN TX8M-ND00 Computer-On-Module
#@SOC: i.MX8MN
#@DESCRIPTION: Machine configuration for Ka-Ro electronics TX8M-ND00 Computer-On-Module
#@MAINTAINER: Ka-Ro electronics GmbH <support@karo-electronics.com>
#@VERSION: 1
#@DATE: 2019-12-02

MACHINEOVERRIDES =. "mx8mn:"

require include/tx8m-base.inc

# u-boot configs
UBOOT_CONFIG[default] = "tx8m-nd00_config"
UBOOT_CONFIG[noenv] = "tx8m-nd00_noenv_config"
UBOOT_CONFIG[mfg] = "tx8m-nd00_mfg_config"
UBOOT_CONFIG[secure-boot] = "tx8m-nd00_sec_config"

# Set DDR FIRMWARE
DDR_FIRMWARE_NAME = " \
        ddr3_dmem_1d_201810.bin \
        ddr3_imem_1d_201810.bin \
"

IMX_BOOT_SEEK = "32"
IMX_BOOT_SOC_TARGET = "iMX8MN"
ATF_PLATFORM = "imx8mn"
ATF_LOAD_ADDR = "0x960000"

# Set U-Boot DTB
UBOOT_DTB_NAME = "imx8mn-tx8m-nd00.dtb"

# Ka-Ro specific Device Tree files to be compiled
KERNEL_DEVICETREE ?= "\
        freescale/imx8mn-tx8m-nd00.dtb \
        freescale/imx8mn-tx8m-nd00-mipi-mb.dtb \
"
```
