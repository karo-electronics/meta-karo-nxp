## conf/machine/tx8p-ml81.conf
```bitbake
#@TYPE: Machine
#@NAME: Ka-Ro electronics NXP i.MX8MP TX8P-ML81 Computer-On-Module
#@SOC: i.MX8MP
#@DESCRIPTION: Machine configuration for Ka-Ro electronics TX8P-ML81 Computer-On-Module
#@MAINTAINER: Ka-Ro electronics GmbH <support@karo-electronics.com>
#@VERSION: 1
#@DATE: 2021-01-21

MACHINEOVERRIDES =. "tx8p:mx8mp:"

require include/tx8m-base.inc

KARO_BOARD_PMIC = "pca9450"

IMXBOOT_TARGETS = "flash_tx8m_lpddr4"

# Set DDR FIRMWARE
DDR_FIRMWARE_NAME = " \
        lpddr4_pmu_train_1d_dmem_201904.bin \
        lpddr4_pmu_train_1d_imem_201904.bin \
        lpddr4_pmu_train_2d_dmem_201904.bin \
        lpddr4_pmu_train_2d_imem_201904.bin \
"

# u-boot configs
UBOOT_CONFIG[default] = "tx8p-ml81_config"
UBOOT_CONFIG[noenv] = "tx8p-ml81_noenv_config"
UBOOT_CONFIG[mfg] = "tx8p-ml81_mfg_config"
UBOOT_CONFIG[secure-boot] = "tx8p-ml81_sec_config"

IMX_BOOT_SEEK = "32"

# Set U-Boot DTB
UBOOT_DTB_NAME = "imx8mp-tx8p-ml81.dtb"

# Ka-Ro specific Device Tree files to be compiled
KERNEL_DEVICETREE = " \
        freescale/imx8mp-tx8p-ml81.dtb \
        freescale/imx8mp-tx8p-ml81-mb7.dtb \
        freescale/imx8mp-tx8p-ml81-lvds-mb.dtb \
"
```

## conf/machine/tx93-5210.conf
```bitbake
#@TYPE: Machine
#@NAME: Ka-Ro electronics NXP i.MX93 TX93-5210 Computer-On-Module
#@SOC: i.MX93
#@DESCRIPTION: Machine configuration for Ka-Ro electronics TX93-5210 Computer-On-Module
#@MAINTAINER: Ka-Ro electronics GmbH <support@karo-electronics.com>
#@VERSION: 1
#@DATE: 2023-01-27

MACHINEOVERRIDES =. "tx93:"

require include/imx93-base.inc

KARO_BOARD_PMIC = "pca9450"

#IMXBOOT_TARGETS = "flash_tx93_lpddr4"
IMX_BOOT_UART_BASE ?= "0x44380000"

# u-boot configs
UBOOT_CONFIG[default] = "tx93-5210_config"
UBOOT_CONFIG[mfg] = "tx93-5210_mfg_config"
UBOOT_CONFIG[noenv] = "tx93-5210_noenv_config"

# Ka-Ro specific Device Tree files to be compiled
KERNEL_DEVICETREE ?= "\
        freescale/imx93-tx93-5210.dtb \
"
```

## conf/machine/txul-5010.conf
```bitbake
#@TYPE: Machine
#@NAME: Ka-Ro electronics TX6UL NAND
#@SOC: i.MX6UL
#@DESCRIPTION: Machine configuration for Ka-Ro electronics TXUL-5010 (i.MX6UL) Computer-On-Module with NAND
#@MAINTAINER: Ka-Ro electronics GmbH <support@karo-electronics.com>

require include/imx6ul-txul-nand.conf

KERNEL_DEVICETREE ?= "imx6ul-tx6ul-0010.dtb"

UBOOT_MACHINE = "tx6ul-0010_config"
```
